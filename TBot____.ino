//

    // ИС Дракон. Маршрутный транслятор.
    // 
    // 1. Изменение 17.07.2023 17:56:31
    // Схема - Процедура

//

    // ==================== Шампур

    // 2.Заголовок / Инициализация

    // 42.Полка / ATOMIC_FS_UPDATE / ?Полка значение
    // -43.Правый комментарий / ?Правый комментарий
#define ATOMIC_FS_UPDATE

    // 25.Полка / WIFI_SSID / "wifi"
    // -44.Правый комментарий / ?Правый комментарий
#define WIFI_SSID "wifi"

    // 26.Полка / WIFI_PASS / "wifirb2011"
#define WIFI_PASS "wifirb2011"

    // 27.Полка / BOT_TOKEN / "&&&&&&&&&&&&&&&&&&&&&&&&&&&&&&&&&&"
#define BOT_TOKEN "&&&&&&&&&&&&&&&&&&&&&&&&&&&&&&&"

    // 28.Ввод / Библиотека / microDS18B20.h
#include <microDS18B20.h>

    // 34.Полка / DS_PIN / 2
#define DS_PIN 2

    // 30.Полка / uint8_t s1_addr[] / 0x28,0x9B,0x73,0x9,0x2C,0x20,0x1,0x57
uint8_t s1_addr[] = {0x28,0x9B,0x73,0x9,0x2C,0x20,0x1,0x57};

    // 31.Полка / uint8_t s2_addr[] / 0x28,0xA4,0x42,0x7,0x2C,0x20,0x1,0xC2
uint8_t s2_addr[] = {0x28,0xA4,0x42,0x7,0x2C,0x20,0x1,0xC2};

    // 23.Действие / ?Действие
MicroDS18B20<DS_PIN, s1_addr> sensor1;

    // 24.Действие / ?Действие
MicroDS18B20<DS_PIN, s2_addr> sensor2;

    // 32.Ввод / Библиотека / FastBot.h
#include <FastBot.h>

    // 33.Действие / FastBot bot(BOT_TOKEN)
FastBot bot(BOT_TOKEN);

    // 3.Конец / Конец

    // ==================== End

//

    // ==================== D end


    // ИС Дракон. Маршрутный транслятор.
    // 
    // 20. Изменение 17.10.2023 9:22:37
    // Схема - Процедура

void setup() {
//

    // ==================== Шампур

    // 21.Заголовок / SETUP

    // 36.Пауза / 2000
delay(2000);

    // 35.Действие / ?Действие
Serial.begin(115200);

    // 37.Вставка / connectWiFi;
connectWiFi();

    // 38.Действие / Пользователи чата
bot.setChatID("123456789, 123456789,");

    // 39.Вывод / Телеграмм / ?Вывод что
bot.sendMessage("Привет");

    // 22.Конец / Конец

    // ==================== End

//  
}

    // ==================== D end


    // ИС Дракон. Маршрутный транслятор.
    // 
    // 45. Изменение 17.10.2023 10:00:40
    // Схема - Процедура

void connectWiFi() {
//

    // ==================== Шампур

    // 46.Заголовок / connectWiFi

    // 47.Действие / ?Действие
WiFi.begin(WIFI_SSID, WIFI_PASS);

L50: ;
    // 50.Вопрос / ?Вопрос - Нет
if (!(WiFi.status() != WL_CONNECTED)) goto L53; 

    // 114.Вывод / COM Port / "Connected"
Serial.println("Connected");

    // 52.Конец / Конец
goto L_end_45 ; 

    // ==================== Шампур

L53: ;
    // 53.Пауза / 500
delay(500);

    // 54.Вывод / COM Port / .
Serial.print(".");

    // 55.Вопрос / ?Вопрос - Нет
if (!(millis() > 15000)) goto L50; 

    // 57.Действие / Перезагрузка
 ESP.restart();
goto L50 ; 

    // ==================== End

L_end_45: ;
//
}

    // ==================== D end


    // ИС Дракон. Маршрутный транслятор.
    // 
    // 4. Изменение 17.10.2023 9:57:48
    // Схема - Процедура

void loop() {
//

    // ==================== Шампур

    // 5.Заголовок / LOOP

    // 7.Имя ветки / Начало

    // 40.Вставка / newMsg
bot.attach(newMsg);

    // 8.Адрес / Конец

    // ==================== Шампур

    // 13.Имя ветки / Конец

    // 41.Действие / Тик-Так
 bot.tick();

    // 14.Конец / Конец

    // ==================== End

//
}

    // ==================== D end


    // ИС Дракон. Маршрутный транслятор.
    // 
    // 60. Изменение 17.10.2023 9:53:21
    // Схема - Процедура

void newMsg(FB_msg& msg) {

    // ==================== Шампур

    // 61.Заголовок / newMsg

    // 67.Имя ветки / Обновление

    // 76.Вопрос / Обновление прислал Администратор? - Нет
if (!(msg.OTA && msg.chatID == "&&&&&&&&620")) goto L78; 

    // 80.Вопрос / файл имеет нужное имя? - Нет
if (!(msg.OTA && msg.fileName == "update.bin")) goto L78; 

    // 86.Действие / Обновить
bot.updateFS();

    // 93.Адрес / Команды

    // ==================== Шампур

    // 140.Адрес / Конец

    // ==================== Шампур

    // 68.Имя ветки / Команды

    // 71.Вопрос / Команда Справка? - Нет
if (!(msg.text=="help"||msg.text=="справка")) goto L89; 

L89: ;
    // 89.Вопрос / Команда Опросит датчики? - Нет
if (!(msg.text=="opros"||msg.text=="опрос")) goto L73; 

    // 94.Вставка / Вызываем функцию опроса датчиков
opros();

    // 100.Адрес / //

    // ==================== Шампур

    // 69.Имя ветки / //

L73: ;
    // 73.Вопрос / ?Вопрос - Нет
if (!(//msg.text=="help"||msg.text=="справка")) goto L91; 

    // 79.Вывод / Телеграмм / Справку
//bot.sendMessage("\tСправка\n      \n Бот разработан для нужд ГКУ РБ ХОЗУ ИЭО \n Цель данного Бота дистанционный контроль температуры подготовленного воздуха (система вентиляции и кондиционирования воздуха\n ");

L91: ;
    // 91.Вопрос / Команда Опросит датчики? - Нет
if (!(//msg.text=="opros"||msg.text=="опрос")) goto L78; 

    // 95.Вставка / Вызываем функцию опроса датчиков
//opros();

    // 101.Адрес / Конец

    // ==================== Шампур

    // 70.Имя ветки / Конец

L78: ;
    // 78.Вывод / Телеграмм / П.Н.Х.
bot.sendMessage("Вы не мой хозяин!");

    // 75.Конец / Конец

    // ==================== End

}
//

    // ==================== D end

//
